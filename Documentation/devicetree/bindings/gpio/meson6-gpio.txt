## Documentation/devicetree/bindings/gpio/meson6-gpio.txt
```
Amlogic Meson6 GPIO controller

Required properties:
- compatible: must be "amlogic,meson6-gpio"
- reg: three register regions, in this order: direction (EN_N), output and
  input
- gpio-controller: marks the node as a GPIO controller
- #gpio-cells: must be <2>; the first cell is the line offset and the second
  cell contains GPIO flags
- ngpios: number of GPIO lines implemented by the bank

The EN_N direction register is active low: a set bit selects input mode and a
clear bit selects output mode.

Optional GPIO interrupt router properties:
- a fourth reg region containing EDGE_POL, SEL0, SEL1 and FILTER
- amlogic,irq-slot: router slot number, 0 through 7
- amlogic,irq-selector: Meson6 vendor pad selector, 0 through 255
- amlogic,irq-trigger: 0 for high level, 1 for low level, 2 for rising edge,
  or 3 for falling edge
- amlogic,irq-filter: router filter value, 0 through 7

The four amlogic,irq-* properties and the fourth register region must be
present together. The router feeds a separate GIC interrupt, so consumers
describe that GIC interrupt directly.

Example:

	gpio_a: gpio@c1108030 {
		compatible = "amlogic,meson6-gpio";
		reg = <0xc1108030 0x4>,
		      <0xc1108034 0x4>,
		      <0xc1108038 0x4>,
		      <0xc1109880 0x10>;
		gpio-controller;
		#gpio-cells = <2>;
		ngpios = <28>;
		amlogic,irq-slot = <0>;
		amlogic,irq-selector = <170>;
		amlogic,irq-trigger = <3>;
		amlogic,irq-filter = <7>;
	};
```

## Documentation/devicetree/bindings/input/touchscreen/gt82x-g04.txt
```
Goodix GT82X touchscreen on the Meson6 G04 tablet

Required properties:
- compatible: must be "goodix,gt82x-g04"
- reg: I2C address, normally <0x5d>
- interrupts: GIC interrupt fed by the configured Meson6 GPIO IRQ router
- interrupt-gpios: GPIO connected to the controller interrupt output
- power-gpios: GPIO controlling touchscreen power
- reset-gpios: active-low reset GPIO

Example:

	touchscreen@5d {
		compatible = "goodix,gt82x-g04";
		reg = <0x5d>;
		interrupt-parent = <&gic>;
		interrupts = <0 64 1>;
		interrupt-gpios = <&gpio_a 16 0>;
		power-gpios = <&gpio_a 23 0>;
		reset-gpios = <&gpio_c 3 0>;
	};
```

## arch/arm/mach-meson/Kconfig
```kconfig
menuconfig ARCH_MESON
	bool "Amlogic Meson SoCs" if ARCH_MULTI_V7
	select GENERIC_IRQ_CHIP
	select ARM_GIC
	select CACHE_L2X0

if ARCH_MESON

config MACH_MESON6
	bool "Amlogic Meson6 (8726MX) SoCs support"
	default ARCH_MESON
	select MESON6_TIMER

config MESON6_G04_RAW_BOOT_DTB
	bool "Inject the G04 DTB address for raw Image boot"
	depends on MACH_MESON6
	help
	  Enable this only for the G04 recovery raw-Image build.  The factory
	  Meson6 U-Boot does not pass a device tree when it decompresses an
	  LZMA uImage, so early head.S supplies the fixed address where the
	  recovery packer places meson6-g04.dtb.

config MACH_MESON8
	bool "Amlogic Meson8 SoCs support"
	default ARCH_MESON
	select MESON6_TIMER

endif
```

## drivers/android/Kconfig
```kconfig
menu "Android"

config ANDROID
	bool "Android Drivers"
	---help---
	  Enable support for various drivers needed on the Android platform

if ANDROID

config ANDROID_BINDER_IPC
	bool "Android Binder IPC Driver"
	depends on MMU
	default n
	---help---
	  Binder is used in Android for both communication between processes,
	  and remote method invocation.

	  This means one Android process can call a method/routine in another
	  Android process, using Binder to identify, invoke and pass arguments
	  between said processes.

config ANDROID_BINDER_IPC_32BIT
	bool
	depends on !64BIT && ANDROID_BINDER_IPC
	default y
	---help---
	  The Binder API has been changed to support both 32 and 64bit
	  applications in a mixed environment.

	  Enable this to support an old 32-bit Android user-space (v4.4 and
	  earlier).

	  Note that enabling this will break newer Android user-space.

config ANDROID_RAM_CONSOLE
	bool "Android RAM buffer console"
	depends on OF
	default n
	help
	  Keep the kernel console in a reserved RAM ring buffer.  On the next
	  boot, the previous contents are exposed through /proc/last_kmsg.

config ANDROID_RAM_CONSOLE_ENABLE_VERBOSE
	bool "Enable verbose messages on the Android RAM console"
	depends on ANDROID_RAM_CONSOLE
	default y

config ANDROID_RAM_CONSOLE_EARLY_INIT
	bool "Initialize Android RAM console before platform drivers"
	depends on ANDROID_RAM_CONSOLE
	default n
	help
	  Map and register the persistent RAM console during console_init.
	  This captures the existing printk ring before device probing starts.

config ANDROID_RAM_CONSOLE_EARLY_PHYS_ADDR
	hex "Physical address of the early Android RAM console"
	depends on ANDROID_RAM_CONSOLE_EARLY_INIT
	default 0x8a300000

config ANDROID_RAM_CONSOLE_EARLY_SIZE
	hex "Size of the early Android RAM console"
	depends on ANDROID_RAM_CONSOLE_EARLY_INIT
	default 0x00100000

endif # if ANDROID

endmenu
```
